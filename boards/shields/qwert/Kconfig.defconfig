## boards/shields/qwert/Kconfig.defconfig
```kconfig
if SHIELD_QWERT_LEFT

config ZMK_KEYBOARD_NAME
    default "qwert"

config ZMK_SPLIT_ROLE_CENTRAL
    default y

endif # SHIELD_QWERT_LEFT

if SHIELD_QWERT_LEFT || SHIELD_QWERT_RIGHT

config ZMK_SPLIT
    default y

endif # SHIELD_QWERT_LEFT || SHIELD_QWERT_RIGHT
```

## boards/shields/qwert/Kconfig.shield
```kconfig
config SHIELD_QWERT_LEFT
    def_bool $(shields_list_contains,qwert_left)

config SHIELD_QWERT_RIGHT
    def_bool $(shields_list_contains,qwert_right)
```
